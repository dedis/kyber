## conf/local.conf
```bitbake
[general]
remote_peers = "buffer://1"
endpoints = "buffer://1"
local_nodes = 20
log = "/tmp/dissent.log"
local_id="HJf-qfK7oZVR3dOqeUQcM8TGeVA="
leader_id="HJf-qfK7oZVR3dOqeUQcM8TGeVA="
subgroup_policy = "ManagedSubgroup"
session_type = "csbulk"
console = true
web_server_url=http://127.0.0.1:8080
entry_tunnel_url = "tcp://127.0.0.1:8081"
exit_tunnel = true
```
